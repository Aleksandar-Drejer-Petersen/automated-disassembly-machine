#pragma once
#include <FastAccelStepper.h>

// Thin compatibility shim: exposes the AccelStepper API that the rest of
// the codebase uses, but drives a FastAccelStepper underneath so that step
// pulses are generated by hardware Timer1 interrupts rather than in software.
// This eliminates step-skipping caused by loop-timing jitter.
class StepperWrapper {
public:
  FastAccelStepper* _s          = nullptr;
  int32_t           _targetPos  = 0;
  uint32_t          _speedCapHz = UINT32_MAX;
  uint32_t          _accelCap   = UINT32_MAX;

  void init(FastAccelStepper* s) { _s = s; _targetPos = 0; }

  // Call once after init() to set hard limits; any later setMaxSpeed/setAcceleration
  // call is silently clamped to these values.
  void setCap(float maxSpeedHz, float maxAccel) {
    _speedCapHz = (uint32_t)(maxSpeedHz + 0.5f);
    _accelCap   = (uint32_t)(maxAccel   + 0.5f);
  }

  void setMaxSpeed(float v) {
    uint32_t hz = (uint32_t)(v + 0.5f);
    if (hz > _speedCapHz) hz = _speedCapHz;
    if (_s) _s->setSpeedInHz(hz);
  }

  void setAcceleration(float v) {
    uint32_t a = (uint32_t)(v + 0.5f);
    if (a > _accelCap) a = _accelCap;
    if (_s) _s->setAcceleration(a);
  }

  void moveTo(long pos) {
    _targetPos = (int32_t)pos;
    if (_s) _s->moveTo(_targetPos);
  }

  void move(long steps) {
    _targetPos = _s ? _s->getCurrentPosition() + (int32_t)steps : _targetPos + (int32_t)steps;
    if (_s) _s->move((int32_t)steps);
  }

  long currentPosition() {
    return _s ? (long)_s->getCurrentPosition() : 0L;
  }

  // Immediate stop + position reset (used for homing calibration and hard stops).
  void setCurrentPosition(long pos) {
    _targetPos = (int32_t)pos;
    if (_s) _s->forceStopAndNewPosition(_targetPos);
  }

  // Returns 0 when the motor has fully stopped and is at its target position.
  // Checking isRunning() alone is not sufficient: after moveTo() is called
  // the Timer1 ISR may not have fired yet, leaving isRunning() momentarily
  // false even though the move has just been queued.  The position check
  // closes that window — if we're not at the target we are not done.
  long distanceToGo() {
    if (!_s) return 0L;
    long remaining = (long)(_targetPos - _s->getCurrentPosition());
    if (remaining != 0) return remaining;
    if (_s->isRunning()) return 1L;  // decelerating toward target
    return 0L;
  }

  // Decelerated stop.
  void stop() {
    if (_s) _s->stopMove();
  }

  // No-op: FastAccelStepper generates pulses via hardware interrupt, not run().
  void run() {}
};
