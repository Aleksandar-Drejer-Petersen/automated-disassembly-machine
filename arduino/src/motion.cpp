#include "motion.h"
#include <math.h>

long mmToSteps(float mm, float pitchMm) {
  return lround((double)mm * (double)AXIS_STEPS_PER_REV / (double)pitchMm);
}

float stepsToMm(long steps, float pitchMm) {
  return (float)steps * pitchMm / (float)AXIS_STEPS_PER_REV;
}

long revToSteps(float rev, long stepsPerRev) {
  return lround((double)rev * (double)stepsPerRev);
}

float getAxisPositionMm(Axis &a) {
  return stepsToMm(a.motor->currentPosition(), a.pitchMm) / a.userDirSign;
}

long userMmToMotorSteps(Axis &a, float mm) {
  return a.userDirSign * mmToSteps(mm, a.pitchMm);
}

long userPositionMmToMotorSteps(Axis &a, float positionMm) {
  return a.userDirSign * mmToSteps(positionMm, a.pitchMm);
}

void runMotorsNow() {
  // XYZ pulses are generated by hardware Timer1 interrupts — no run() needed.
  screwStepper.run();
}

bool axisIsMoving() {
  for (int i = 0; i < 3; i++) {
    if (axes[i].motor->distanceToGo() != 0) return true;
  }
  return false;
}

bool anyMotionActive() {
  if (axisIsMoving()) return true;
  if (screwStepper.distanceToGo() != 0) return true;
  return false;
}

void setupMotor(AccelStepper &motor, float maxSpeed, float accel) {
  motor.setMaxSpeed(maxSpeed);
  motor.setAcceleration(accel);
  motor.setMinPulseWidth(STEP_PULSE_US);
}

float clampAxisTarget(Axis &a, float targetMm) {
  if (targetMm > a.maxMm) return a.maxMm;
  if (targetMm < 0.0)     return 0.0;
  return targetMm;
}

bool stepsMoveTowardHome(Axis &a, long steps) {
  if (steps == 0) return false;
  bool movingPositive = steps > 0;
  return (movingPositive && a.dirTowardHome) || (!movingPositive && !a.dirTowardHome);
}

void moveXYZAbsInternal(float xMm, float yMm, float zMm) {
  float targets[3] = {xMm, yMm, zMm};
  for (int i = 0; i < 3; i++) {
    Axis &a = axes[i];
    float clamped    = clampAxisTarget(a, targets[i]);
    long targetSteps = userPositionMmToMotorSteps(a, clamped);
    a.motor->setMaxSpeed(a.maxSpeed);
    a.motor->setAcceleration(a.accel);
    a.motor->moveTo(targetSteps);
    a.homing     = false;
    a.retracting = false;
  }
}

void moveXYAbsInternal(float xMm, float yMm) {
  float targets[2] = {xMm, yMm};
  for (int i = 0; i < 2; i++) {
    Axis &a = axes[i];
    float clamped    = clampAxisTarget(a, targets[i]);
    long targetSteps = userPositionMmToMotorSteps(a, clamped);
    a.motor->setMaxSpeed(a.maxSpeed);
    a.motor->setAcceleration(a.accel);
    a.motor->moveTo(targetSteps);
    a.homing     = false;
    a.retracting = false;
  }
}

void moveZAbsInternal(float zMm) {
  Axis &z = axes[2];
  float clamped    = clampAxisTarget(z, zMm);
  long targetSteps = userPositionMmToMotorSteps(z, clamped);
  z.motor->setMaxSpeed(z.maxSpeed);
  z.motor->setAcceleration(z.accel);
  z.motor->moveTo(targetSteps);
  z.homing     = false;
  z.retracting = false;
}

void moveYRelInternal(float mm) {
  Axis &y      = axes[1];
  float current = getAxisPositionMm(y);
  float targetMm = clampAxisTarget(y, current + mm);
  long targetSteps = userPositionMmToMotorSteps(y, targetMm);
  y.motor->setMaxSpeed(y.maxSpeed);
  y.motor->setAcceleration(y.accel);
  y.motor->moveTo(targetSteps);
  y.homing     = false;
  y.retracting = false;
}

void screwRevInternal(float revs) {
  long steps = revToSteps(SCREW_MANUAL_DIR * fabs(revs), SCREW_STEPS_PER_REV);
  screwStepper.setMaxSpeed(SCREW_MAX_SPEED);
  screwStepper.setAcceleration(SCREW_ACCEL);
  screwStepper.move(steps);
}

bool startRelativeMove(int axisIdx, float moveMm) {
  Axis &a = axes[axisIdx];

  if (autoAllActive())     { Serial.println("AUTO ALL is active. Send S to cancel.");      return false; }
  if (grabPlaceActive())   { Serial.println("Grab/place is active. Send S to cancel.");    return false; }
  if (autoUnscrewActive()) { Serial.println("AUTO UNSCREW is active. Send S to cancel.");  return false; }
  if (positionActive())    { Serial.println("Position routine is active. Send S to cancel."); return false; }
  if (unscrewState != UNSCREW_IDLE) { Serial.println("Unscrew sequence is active. Send S to cancel."); return false; }
  if (axisIsMoving())      { Serial.println("Another axis is already moving. Wait or send S."); return false; }

  float currentMm       = getAxisPositionMm(a);
  float limitedTargetMm = clampAxisTarget(a, currentMm + moveMm);
  long  targetSteps     = userPositionMmToMotorSteps(a, limitedTargetMm);
  long  delta           = targetSteps - a.motor->currentPosition();

  if (delta == 0) {
    Serial.print("No movement. Axis "); Serial.print(a.name);
    Serial.print(" is at "); Serial.print(currentMm, 3); Serial.println(" mm.");
    return false;
  }

  if (digitalRead(a.limitPin) == LOW && stepsMoveTowardHome(a, delta)) {
    Serial.print("BLOCKED: "); Serial.print(a.name); Serial.println(" is already at switch.");
    return false;
  }

  if (SAFE_Z_FIRST && axisIdx != 2 && axes[2].motor->currentPosition() != 0) {
    Serial.println("SAFETY: Z not at home. Home Z before moving XY (send h).");
    return false;
  }

  a.motor->setMaxSpeed(a.maxSpeed);
  a.motor->setAcceleration(a.accel);
  a.motor->moveTo(targetSteps);
  a.homing     = false;
  a.retracting = false;

  return true;
}

bool startAbsoluteMoveAll(float xTargetMm, float yTargetMm, float zTargetMm) {
  if (grabPlaceActive())   { Serial.println("Grab/place is active. Send S to cancel."); return false; }
  if (positionActive())    { Serial.println("Position routine is active. Send S to cancel."); return false; }
  if (unscrewState != UNSCREW_IDLE) { Serial.println("Unscrew sequence is active. Send S to cancel."); return false; }
  if (axisIsMoving())      { Serial.println("Another axis is already moving. Wait or send S."); return false; }

  float requestedTargets[3] = {xTargetMm, yTargetMm, zTargetMm};
  float limitedTargets[3];
  long  currentSteps[3];
  long  targetSteps[3];
  bool  anyMovement = false;

  for (int i = 0; i < 3; i++) {
    Axis &a          = axes[i];
    currentSteps[i]  = a.motor->currentPosition();
    limitedTargets[i] = clampAxisTarget(a, requestedTargets[i]);
    targetSteps[i]   = userPositionMmToMotorSteps(a, limitedTargets[i]);
    long delta       = targetSteps[i] - currentSteps[i];
    if (delta != 0) anyMovement = true;
    if (digitalRead(a.limitPin) == LOW && stepsMoveTowardHome(a, delta)) {
      Serial.print("BLOCKED: "); Serial.print(a.name); Serial.println(" is already at switch.");
      return false;
    }
  }

  if (!anyMovement) { Serial.println("No movement. All axes are already at target."); return false; }

  if (SAFE_Z_FIRST) {
    bool xyWillMove = (targetSteps[0] != currentSteps[0]) || (targetSteps[1] != currentSteps[1]);
    if (xyWillMove && axes[2].motor->currentPosition() != 0) {
      Serial.println("SAFETY: Z not at home. Home Z before moving XY (send h).");
      return false;
    }
  }

  for (int i = 0; i < 3; i++) {
    Axis &a = axes[i];
    long delta = targetSteps[i] - a.motor->currentPosition();
    a.motor->setMaxSpeed(a.maxSpeed);
    a.motor->setAcceleration(a.accel);
    if (delta != 0) a.motor->move(delta);
    a.homing     = false;
    a.retracting = false;
  }

  return true;
}

void startScrewMove(float revolutions) {
  if (autoAllActive())     { Serial.println("AUTO ALL is active. Send S to cancel."); return; }
  if (grabPlaceActive())   { Serial.println("Grab/place is active. Send S to cancel."); return; }
  if (autoUnscrewActive()) { Serial.println("AUTO UNSCREW is active. Send S to cancel."); return; }
  if (positionActive())    { Serial.println("Position routine is active. Send S to cancel."); return; }
  if (unscrewState != UNSCREW_IDLE) { Serial.println("Unscrew sequence is active. Send S to cancel."); return; }

  long steps = revToSteps(SCREW_MANUAL_DIR * fabs(revolutions), SCREW_STEPS_PER_REV);
  screwStepper.setMaxSpeed(SCREW_MAX_SPEED);
  screwStepper.setAcceleration(SCREW_ACCEL);
  screwStepper.move(steps);

  Serial.print("SCREW: "); Serial.print(fabs(revolutions), 4);
  Serial.print(" rotations = "); Serial.print(steps); Serial.println(" steps");
}

void stopAll() {
  for (int i = 0; i < 3; i++) {
    axes[i].motor->stop();
    axes[i].homing     = false;
    axes[i].retracting = false;
  }
  screwStepper.stop();
  clearUnscrewState();
  clearPositionState();
  clearAutoUnscrewState();
  clearAutoAllState();
  clearGrabPlaceState();
  Serial.println("Stopping all motors with deceleration.");
}

void hardStopAll() {
  for (int i = 0; i < 3; i++) {
    axes[i].motor->setCurrentPosition(axes[i].motor->currentPosition());
    axes[i].homing     = false;
    axes[i].retracting = false;
  }
  screwStepper.setCurrentPosition(screwStepper.currentPosition());
  clearUnscrewState();
  clearPositionState();
  clearAutoUnscrewState();
  clearAutoAllState();
  clearGrabPlaceState();
  Serial.println("Hard stop.");
}
